## base_external/Config.in
```kconfig
source "$BR2_EXTERNAL_assignment_base_PATH/package/serversocket/Config.in"
source "$BR2_EXTERNAL_assignment_base_PATH/package/fbwrite/Config.in"
```

## base_external/package/fbwrite/Config.in
```kconfig
config BR2_PACKAGE_FBWRITE
	bool "fbwrite"
	help
	  Includes the serversocket executable and start-stop script
```

## base_external/package/serversocket/Config.in
```kconfig
config BR2_PACKAGE_SERVERSOCKET
	bool "serversocket"
	help
	  Includes the serversocket executable and start-stop script
```
